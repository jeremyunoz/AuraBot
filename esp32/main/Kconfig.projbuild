## esp32/main/Kconfig.projbuild
```kconfig
menu "AuraBot Configuration"

    config ESP_WIFI_SSID
        string "WiFi SSID"
        default "myssid"
        help
            SSID (network name) for the example to connect to.

    config ESP_WIFI_PASSWORD
        string "WiFi Password"
        default "mypassword"
        help
            WiFi password (WPA or WPA2) for the example to use.

    choice ESP_WIFI_SAE_MODE
        prompt "WPA3 SAE mode selection"
        default ESP_STATION_EXAMPLE_WPA3_SAE_PWE_BOTH
        help
            Select mode for SAE as Hunt and Peck, H2E or both.
        config ESP_STATION_EXAMPLE_WPA3_SAE_PWE_HUNT_AND_PECK
            bool "HUNT AND PECK"
        config ESP_STATION_EXAMPLE_WPA3_SAE_PWE_HASH_TO_ELEMENT
            bool "H2E"
            depends on ESP_WIFI_ENABLE_SAE_H2E
        config ESP_STATION_EXAMPLE_WPA3_SAE_PWE_BOTH
            bool "BOTH"
            depends on ESP_WIFI_ENABLE_SAE_H2E
    endchoice

    config ESP_WIFI_PW_ID
        string "PASSWORD IDENTIFIER"
        depends on  ESP_STATION_EXAMPLE_WPA3_SAE_PWE_HASH_TO_ELEMENT|| ESP_STATION_EXAMPLE_WPA3_SAE_PWE_BOTH
        default ""
        help
            password identifier for SAE H2E

    config ESP_MAXIMUM_RETRY
        int "Maximum retry"
        default 5
        help
            Set the Maximum retry to avoid station reconnecting to the AP unlimited when the AP is really inexistent.

    
    choice ESP_WIFI_SCAN_AUTH_MODE_THRESHOLD
        prompt "WiFi Scan auth mode threshold"
        default ESP_WIFI_AUTH_WPA2_PSK
        help
            The weakest authmode to accept in the scan mode.
            This value defaults to ESP_WIFI_AUTH_WPA2_PSK in case password is present and ESP_WIFI_AUTH_OPEN is used.
            Please select ESP_WIFI_AUTH_WEP/ESP_WIFI_AUTH_WPA_PSK in case AP is operating in WEP/WPA mode.

        config ESP_WIFI_AUTH_OPEN
            bool "OPEN"
        config ESP_WIFI_AUTH_WEP
            bool "WEP"
        config ESP_WIFI_AUTH_WPA_PSK
            bool "WPA PSK"
        config ESP_WIFI_AUTH_WPA2_PSK
            bool "WPA2 PSK"
        config ESP_WIFI_AUTH_WPA_WPA2_PSK
            bool "WPA/WPA2 PSK"
        config ESP_WIFI_AUTH_WPA3_PSK
            bool "WPA3 PSK"
        config ESP_WIFI_AUTH_WPA2_WPA3_PSK
            bool "WPA2/WPA3 PSK"
        config ESP_WIFI_AUTH_WAPI_PSK
            bool "WAPI PSK"
    endchoice

    menu "Speaker (ES8311 Codec)"
        config SPEAKER_ENABLE
            bool "Enable speaker output"
            default n
            help
                Enable speaker driver using esp_codec_dev and ES8311 codec.
                Requires I2C (control) and I2S (audio) connected to the codec.

        config SPEAKER_I2C_SCL_GPIO
            int "I2C SCL GPIO"
            depends on SPEAKER_ENABLE
            default 8
            help
                I2C clock pin for codec control (ES8311). ESP32-P4-WIFI6: GPIO8.

        config SPEAKER_I2C_SDA_GPIO
            int "I2C SDA GPIO"
            depends on SPEAKER_ENABLE
            default 7
            help
                I2C data pin for codec control (ES8311). ESP32-P4-WIFI6: GPIO7.

        config SPEAKER_I2S_BCK_GPIO
            int "I2S BCK (Bit Clock) GPIO"
            depends on SPEAKER_ENABLE
            default 12
            help
                I2S bit clock (SCLK). ESP32-P4-WIFI6: GPIO12.

        config SPEAKER_I2S_WS_GPIO
            int "I2S WS (Word Select) GPIO"
            depends on SPEAKER_ENABLE
            default 10
            help
                I2S word select (LRCK). ESP32-P4-WIFI6: GPIO10.

        config SPEAKER_I2S_DOUT_GPIO
            int "I2S DOUT (Data Out) GPIO"
            depends on SPEAKER_ENABLE
            default 9
            help
                I2S data output to codec DAC. Matches i2s_es8311 example: ESP32-P4 GPIO9.

        config SPEAKER_I2S_DIN_GPIO
            int "I2S DIN (Data In) GPIO (-1 = unused)"
            depends on SPEAKER_ENABLE
            default 11
            help
                I2S data input from codec ADC. Matches i2s_es8311 example: ESP32-P4 GPIO11. Use -1 for output-only.

        config SPEAKER_I2S_MCK_GPIO
            int "I2S MCK (Master Clock) GPIO (-1 = unused)"
            depends on SPEAKER_ENABLE
            default 13
            help
                I2S master clock. ESP32-P4-WIFI6: GPIO13. Use -1 if unused.

        config SPEAKER_PA_GPIO
            int "PA (Power Amplifier) enable GPIO"
            depends on SPEAKER_ENABLE
            default 53
            help
                GPIO to enable the speaker power amplifier (NS4150B). ESP32-P4-WIFI6: GPIO53.

    endmenu

    config MQTT_ENABLE
        bool "Enable MQTT client (broker required for full pipeline)"
        default n
        help
            When disabled, wake flow skips MQTT connect so voice session can be tested without a broker. Set to y for full pipeline with Pi5/MQTT.

    menu "Voice session (online TTS / Pi5 WebSocket)"
        config VOICE_SESSION_ENABLE
            bool "Enable voice session (Opus + WebSocket to Pi5)"
            default n
            help
                When enabled, after wake and when ACTIVE, capture mic PCM, encode with Opus,
                and send to Pi5 over WebSocket. Receive and play TTS from server.

        config VOICE_WS_URI
            string "WebSocket URI for Pi5 voice server"
            depends on VOICE_SESSION_ENABLE
            default "ws://pi5.local:8765/voice"
            help
                URI for the Pi5 WebSocket voice server (e.g. ws://host:port/path).
                Using pi5.local requires mDNS resolution and can add 1-3+ seconds to
                connect. For faster connect use the Pi's IP: ws://192.168.x.x:8765/voice.
    endmenu

endmenu
```
